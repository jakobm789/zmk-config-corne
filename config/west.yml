## config/west.yml
```yaml
manifest:
  remotes:
    - name: jakobm789
      url-base: https://github.com/jakobm789/
    - name: urob
      url-base: https://github.com/urob
  projects:
    - name: zmk
      remote: jakobm789
      revision: main
      import: app/west.yml
    - name: zmk-helpers
      remote: urob
      revision: main
  self:
    path: config
```
